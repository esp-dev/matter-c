## components/matter_c/Kconfig
```kconfig
menu "Matter C library"
config MATTER_C_EVENTS_CAPACITY
    int "Retained event limit"
    range 16 1024
    default 128
config MATTER_C_TRANSPORT_CAPACITY
    int "Transport slot limit"
    range 52 128
    default 56
config MATTER_C_PROFILE_ALLOCATIONS
    bool "Single-owner laboratory allocation accounting and fault injection"
    default n
    help
        Instrument only the library's libc allocation calls. Application and
        Mbed TLS/SDK allocations are excluded. One application owner task must
        serialize all library instances and profiler access. Not an allocator
        replacement or a production concurrency facility.
endmenu
```

## components/matter_c_esp32/Kconfig
```kconfig
menu "Matter C ESP ports"
config MATTER_C_ESP32_BLE
    bool "Matter commissioning over NimBLE/BTP"
    depends on BT_NIMBLE_ENABLED
    default n
    help
        Optional phase-owned peripheral transport. Uses the application's owner
        scheduler and shares runtime limits with UDP; does not enable UDP PASE.
config MATTER_C_ESP32_UDP_TRACE
    bool "Trace transport and Wi-Fi state (no payloads or credentials)"
    default n
    help
        Development-only UDP/BTP state/error counters and Wi-Fi operation flags
        on the console. Never logs packet payloads, SSIDs or credentials.
        Leave disabled in silent release images.
endmenu
```

## examples/esp32-memory/main/Kconfig.projbuild
```kconfig
menu "Matter C memory laboratory"
config MATTER_C_LAB_SELF_TESTS
    bool "Run existing host test suites on the MCU before profiling"
    default y
    help
        These include maximum PBKDF2 and extensive negative certificate tests.
        Disable in a separate profiling build to exclude their heap/stack peak.
endmenu
```

## examples/esp32-memory/sdkconfig.defaults
```kconfig
CONFIG_IDF_TARGET="esp32c6"
CONFIG_ESPTOOLPY_FLASHSIZE_4MB=y
CONFIG_PARTITION_TABLE_SINGLE_APP_LARGE=y
CONFIG_ESP_MAIN_TASK_STACK_SIZE=12288
CONFIG_FREERTOS_USE_TRACE_FACILITY=y
CONFIG_MATTER_C_PROFILE_ALLOCATIONS=y
CONFIG_MBEDTLS_X509_CREATE_C=y
CONFIG_MBEDTLS_X509_CSR_PARSE_C=y
CONFIG_MBEDTLS_X509_CSR_WRITE_C=y
CONFIG_MBEDTLS_CCM_C=y
CONFIG_MBEDTLS_ECP_C=y
CONFIG_MBEDTLS_ECDSA_C=y
CONFIG_MBEDTLS_SHA1_C=y
CONFIG_MBEDTLS_PKCS5_C=y
CONFIG_MBEDTLS_HKDF_C=y
# Preserve the backend's software point blinding and entropy-failure contract.
CONFIG_MBEDTLS_HARDWARE_ECC=n
```

## examples/esp32-runtime/main/Kconfig.projbuild
```kconfig
menu "Matter C runtime laboratory"
config MATTER_C_RUNTIME_USERCASE
    bool "Matched user-case comparison without startup fault fixtures"
    default n
    help
        NVS lab_wifi provisioning, phase heap observer and normal RGB runtime.
        Explicitly skips the old constructor/store/radio crash fixtures. Their
        validation remains a separate laboratory image, not a typical workload.
config MATTER_C_RUNTIME_NATIVE_OTA
    bool "Signed ESP image OTA with actual partition installation and rollback"
    depends on BOOTLOADER_APP_ROLLBACK_ENABLE && SECURE_SIGNED_ON_UPDATE_NO_SECURE_BOOT
    default n
    help
        Requires dual OTA app partitions, numeric project version and a signed
        initial image. Never enables hardware Secure Boot or writes eFuses.
config MATTER_C_RUNTIME_RGB
    bool "Experimental EP1 RGB light and DevKitM-1 GPIO8 WS2812"
    default n
    help
        Adds a volatile development light using standard OnOff, MoveToLevel,
        MoveToLevelWithOnOff, MoveToHueAndSaturation and Stop commands.
        This is an incomplete light profile for memory/IM/hardware testing,
        not a complete or certified Extended Color Light implementation.
config MATTER_C_RUNTIME_SOAK
    bool "Owner-thread soak telemetry and local UART fault controls"
    depends on MATTER_C_PROFILE_ALLOCATIONS
    default n
    help
        Samples internal heap every 100 ms and logs every five seconds.
        Local UART can inject one tracked allocation failure, reconnect the
        radio, drop RX briefly or defer one completion. No capacity changes.
config MATTER_C_RUNTIME_COMPARE_SAMPLER
    bool "SDK timer heap sampler for matched external-stack comparison"
    depends on MATTER_C_RUNTIME_SOAK
    default n
    help
        Adds the same 100 ms SDK timer observer as the ESP-Matter reference.
        Includes short blocking crypto phases missed by owner-loop sampling.
        Timer and observer costs are included. No protocol or limit changes.
config MATTER_C_RUNTIME_HEAP_AUDIT
    bool "Post-teardown heap maps and settled SDK memory samples"
    depends on MATTER_C_RUNTIME_SOAK
    default n
    help
        Laboratory-only allocation-free heap walks and samples through five
        seconds after teardown. Prints addresses/sizes, never block contents.
        UART logs belong in ignored private output. No protocol timer changes.
config MATTER_C_RUNTIME_HEAP_QUEUE_OWNERS
    bool "Record SDK queue/mutex and pthread TLS owners for heap audit"
    depends on MATTER_C_RUNTIME_HEAP_AUDIT
    default n
    help
        Diagnostic link wrappers keep at most 128 live queue/TLS identities and
        creation PCs in static RAM. No allocation or log inside wrappers.
        Changes memory layout; use for attribution, not headline RAM numbers.
config MATTER_C_RUNTIME_HEAP_SETTLE_LONG
    bool "Observe SDK heap through 65 seconds after full teardown"
    depends on MATTER_C_RUNTIME_HEAP_AUDIT
    default n
    help
        Additional post-stop samples through 15/30/65 seconds and a second
        settled map cover long-lived SDK timers without changing their periods.
        UART q completion includes this delay; no protocol drain is extended.
config MATTER_C_RUNTIME_HEAP_SMALL_OWNERS
    bool "Also record allocation callers for requests up to 32 bytes"
    depends on MATTER_C_RUNTIME_HEAP_QUEUE_OWNERS
    default n
    help
        Attribution-only malloc/calloc/realloc, caps-API and small lwIP-pool wrappers reuse an
        enlarged 1024-entry static table. Free/resize forget old identities;
        failure preserves them. Explicit overflow invalidates attribution.
        Adds about 12 KiB BSS; never compare its whole heap to normal images.
config MATTER_C_RUNTIME_CHIP_RESUMPTION
    bool "Explicit CHIP-compatible CASE resumption traffic KDF for lab peers"
    default y
    help
        Mirrors the existing host lab. ConnectedHomeIP and Matter.js0.17.9 use
        the previous resumption ID for SessionResumptionKeys. Disabling selects
        the core's SPEC profile (new Sigma2Resume ID). No ciphertext detection
        or fallback between profiles; both peers must agree.
config MATTER_C_RUNTIME_OOM_SWEEP
    bool "Fault every tracked runtime-constructor allocation once per lab state"
    default y
    help
        Deliberately slow test, completed before serving. Tracks library/adapter
        allocations only, not all internal SDK/PSA failures.
endmenu
```

## examples/esp32-runtime/sdkconfig.defaults
```kconfig
CONFIG_IDF_TARGET="esp32c6"
CONFIG_ESPTOOLPY_FLASHSIZE_4MB=y
CONFIG_PARTITION_TABLE_CUSTOM=y
CONFIG_PARTITION_TABLE_CUSTOM_FILENAME="partitions.csv"
CONFIG_ESP_MAIN_TASK_STACK_SIZE=12288
CONFIG_FREERTOS_USE_TRACE_FACILITY=y
CONFIG_MATTER_C_PROFILE_ALLOCATIONS=y
CONFIG_MATTER_C_RUNTIME_CHIP_RESUMPTION=y
CONFIG_LWIP_IPV6=y
CONFIG_LWIP_TCPIP_CORE_LOCKING=y
CONFIG_LWIP_IP6_REASSEMBLY=n
CONFIG_MDNS_MULTIPLE_INSTANCE=y
CONFIG_MDNS_MAX_SERVICES=10
CONFIG_MBEDTLS_X509_CREATE_C=y
CONFIG_MBEDTLS_X509_CSR_PARSE_C=y
CONFIG_MBEDTLS_X509_CSR_WRITE_C=y
CONFIG_MBEDTLS_CCM_C=y
CONFIG_MBEDTLS_ECP_C=y
CONFIG_MBEDTLS_ECDSA_C=y
CONFIG_MBEDTLS_SHA1_C=y
CONFIG_MBEDTLS_PKCS5_C=y
CONFIG_MBEDTLS_HARDWARE_ECC=n
```
